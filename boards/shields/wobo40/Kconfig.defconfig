## config/west.yml
```yaml
manifest:
  defaults:
    revision: v0.3
  remotes:
    - name: zmkfirmware
      url-base: https://github.com/zmkfirmware
    - name: sekigon-gonnoc
      url-base: https://github.com/sekigon-gonnoc
  projects:
    - name: zmk
      remote: zmkfirmware
      import: app/west.yml
    # PAW3222 トラックボールドライバ
    - name: zmk-driver-paw3222
      remote: sekigon-gonnoc
      revision: main
  self:
    path: config
```
